## drivers/input/touchscreen/nvt_touch_a/Kconfig
```kconfig
#
# Novatek NT36xxx touchscreen driver configuration
#
config TOUCHSCREEN_NT36xxx
	bool "Novatek NT36xxx"
	default y
	help
	  Say Y here if you have a Novatek NT36xxx touchscreen connected
	  to your system.

	  If unsure, say N.

	  To compile this driver as a module, choose M here: the
	  module will be called nvt.
	  
config BOOT_FIRMWARE_UPDATE_NVT_A
	tristate "boot firmware update function for novatek touchscreens"
	depends on TOUCHSCREEN_NVT_A
	help
	  Say Y here if you want to enable boot firmware update.


	  If unsure, say N.
```

## drivers/input/touchscreen/nvt_touch_e7s/Kconfig
```kconfig
#
# Novatek NT36xxx touchscreen driver configuration
#
config TOUCHSCREEN_NVT_E7S
	tristate "Novatek touchscreens NT36xxx"
	help
		Say Y here if you have a Novatek NT36xxx touchscreen connected
		to your system.
		If unsure, say N.

	  If unsure, say N.

	  To compile this driver as a module, choose M here: the
	  module will be called nvt.

config BOOT_FIRMWARE_UPDATE_NVT_E7S
	tristate "boot firmware update function for novatek touchscreens"
	depends on TOUCHSCREEN_NVT_E7S
	help
	  Say Y here if you want to enable boot firmware update.

	  If unsure, say N.
```
